# file: FreeRTOS-Project.ioc
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FREERTOS.BinarySemaphores01=ButtonSemaphore,Dynamic,NULL,Depleted
FREERTOS.Events01=SystemEvents,Dynamic,NULL
FREERTOS.Mutexes01=PrintMutex,Dynamic,NULL,Available
FREERTOS.Queues01=ProcessingQueue,16,SqrtResult_t,0,Dynamic,NULL,NULL
FREERTOS.Tasks01=Task1,24,512,StartTask1,Default,NULL,Dynamic,NULL,NULL;Task2,16,512,StartTask2,Default,NULL,Dynamic,NULL,NULL;Task3,8,512,StartTask3,Default,NULL,Dynamic,NULL,NULL
FREERTOS.Timers01=MonitorTimer,MonitorTimerCallback,osTimerPeriodic,Default,NULL,Dynamic,NULL
Mcu.Family=STM32F4
Mcu.Name=STM32F446R(C-E)Tx
Mcu.Package=LQFP64
NVIC.EXTI15_10_IRQn=true\:5\:0\:true\:false\:true\:true\:true\:true\:true
NVIC.PriorityGroup=NVIC_PRIORITYGROUP_4
NVIC.TIM6_DAC_IRQn=true\:15\:0\:false\:false\:true\:false\:false\:true\:true
NVIC.TimeBase=TIM6_DAC_IRQn
NVIC.TimeBaseIP=TIM6
PA13.Mode=Trace_Asynchronous_SW
PA13.Signal=SYS_JTMS-SWDIO
PA14.Mode=Trace_Asynchronous_SW
PA14.Signal=SYS_JTCK-SWCLK
PB3.Mode=Trace_Asynchronous_SW
PB3.Signal=SYS_JTDO-SWO
PC13.GPIO_ModeDefaultEXTI=GPIO_MODE_IT_RISING
PC13.Signal=GPXTI13
ProjectManager.HeapSize=0x200
ProjectManager.StackSize=0x400
ProjectManager.TargetToolchain=STM32CubeIDE
RCC.CortexFreq_Value=16000000
RCC.USBFreq_Value=96000000
RCC.VCOOutputFreq_Value=192000000
VP_FREERTOS_VS_CMSIS_V2.Mode=CMSIS_V2
VP_SYS_VS_tim6.Mode=TIM6
board=custom

// file: Core/Src/main.c
/* USER CODE BEGIN Header */
/**
  ******************************************************************************
  * @file           : main.c
  * @brief          : Main program body
  ******************************************************************************
  * @attention
  *
  * Copyright (c) 2026 STMicroelectronics.
  * All rights reserved.
  *
  * This software is licensed under terms that can be found in the LICENSE file
  * in the root directory of this software component.
  * If no LICENSE file comes with this software, it is provided AS-IS.
  *
  ******************************************************************************
  */
/* USER CODE END Header */
#include "main.h"
#include "cmsis_os.h"

/* USER CODE BEGIN Includes */
#include <stdio.h>
/* USER CODE END Includes */

/* USER CODE BEGIN PD */
#define EVENT_PROCESSING   (1U << 0)
#define EVENT_BUTTON       (1U << 1)
#define EVENT_MONITOR      (1U << 2)

const char* GetTaskStateName(osThreadState_t state)
{
    switch (state)
    {
        case osThreadRunning:
            return "Running";

        case osThreadReady:
            return "Ready";

        case osThreadBlocked:
            return "Blocked";

        case osThreadTerminated:
            return "Terminated";

        case osThreadInactive:
            return "Inactive";

        case osThreadError:
            return "Error";

        case osThreadReserved:
            return "Reserved";

        default:
            return "Unknown";
    }
}
/* USER CODE END PD */

/* Definitions for Task1 */
osThreadId_t Task1Handle;
const osThreadAttr_t Task1_attributes = {
  .name = "Task1",
  .stack_size = 512 * 4,
  .priority = (osPriority_t) osPriorityNormal,
};
/* Definitions for Task2 */
osThreadId_t Task2Handle;
const osThreadAttr_t Task2_attributes = {
  .name = "Task2",
  .stack_size = 512 * 4,
  .priority = (osPriority_t) osPriorityBelowNormal,
};
/* Definitions for Task3 */
osThreadId_t Task3Handle;
const osThreadAttr_t Task3_attributes = {
  .name = "Task3",
  .stack_size = 512 * 4,
  .priority = (osPriority_t) osPriorityLow,
};
/* Definitions for ProcessingQueue */
osMessageQueueId_t ProcessingQueueHandle;
const osMessageQueueAttr_t ProcessingQueue_attributes = {
  .name = "ProcessingQueue"
};
/* Definitions for MonitorTimer */
osTimerId_t MonitorTimerHandle;
const osTimerAttr_t MonitorTimer_attributes = {
  .name = "MonitorTimer"
};
/* Definitions for PrintMutex */
osMutexId_t PrintMutexHandle;
const osMutexAttr_t PrintMutex_attributes = {
  .name = "PrintMutex"
};
/* Definitions for ButtonSemaphore */
osSemaphoreId_t ButtonSemaphoreHandle;
const osSemaphoreAttr_t ButtonSemaphore_attributes = {
  .name = "ButtonSemaphore"
};
/* Definitions for SystemEvents */
osEventFlagsId_t SystemEventsHandle;
const osEventFlagsAttr_t SystemEvents_attributes = {
  .name = "SystemEvents"
};

void SystemClock_Config(void);
static void MX_GPIO_Init(void);
void StartTask1(void *argument);
void StartTask2(void *argument);
void StartTask3(void *argument);
void MonitorTimerCallback(void *argument);

/* USER CODE BEGIN 0 */

#include <math.h>

float calculate_sqrt(uint32_t number)
{
    return sqrtf((float)number);
}

typedef struct
{
    uint32_t number;
    float result;
} SqrtResult_t;
/* USER CODE END 0 */

int main(void)
{

  /* MCU Configuration--------------------------------------------------------*/

  /* Reset of all peripherals, Initializes the Flash interface and the Systick. */
  HAL_Init();

  /* Configure the system clock */
  SystemClock_Config();

  /* Initialize all configured peripherals */
  MX_GPIO_Init();

  /* Init scheduler */
  osKernelInitialize();
  /* Create the mutex(es) */
  /* creation of PrintMutex */
  PrintMutexHandle = osMutexNew(&PrintMutex_attributes);

  /* Create the semaphores(s) */
  /* creation of ButtonSemaphore */
  ButtonSemaphoreHandle = osSemaphoreNew(1, 0, &ButtonSemaphore_attributes);

  /* Create the timer(s) */
  /* creation of MonitorTimer */
  MonitorTimerHandle = osTimerNew(MonitorTimerCallback, osTimerPeriodic, NULL, &MonitorTimer_attributes);

  /* Create the queue(s) */
  /* creation of ProcessingQueue */
  ProcessingQueueHandle = osMessageQueueNew (16, sizeof(SqrtResult_t), &ProcessingQueue_attributes);

  /* Create the thread(s) */
  /* creation of Task1 */
  Task1Handle = osThreadNew(StartTask1, NULL, &Task1_attributes);

  /* creation of Task2 */
  Task2Handle = osThreadNew(StartTask2, NULL, &Task2_attributes);

  /* creation of Task3 */
  Task3Handle = osThreadNew(StartTask3, NULL, &Task3_attributes);

  /* creation of SystemEvents */
  SystemEventsHandle = osEventFlagsNew(&SystemEvents_attributes);

  /* USER CODE BEGIN RTOS_EVENTS */
  /* add events, ... */
  osTimerStart(MonitorTimerHandle, 20000);
  /* USER CODE END RTOS_EVENTS */

  /* Start scheduler */
  osKernelStart();

  /* We should never get here as control is now taken by the scheduler */

  /* Infinite loop */
  while (1)
  {

  }
}

void SystemClock_Config(void)
{
  RCC_OscInitTypeDef RCC_OscInitStruct = {0};
  RCC_ClkInitTypeDef RCC_ClkInitStruct = {0};

  /** Configure the main internal regulator output voltage
  */
  __HAL_RCC_PWR_CLK_ENABLE();
  __HAL_PWR_VOLTAGESCALING_CONFIG(PWR_REGULATOR_VOLTAGE_SCALE3);

  /** Initializes the RCC Oscillators according to the specified parameters
  * in the RCC_OscInitTypeDef structure.
  */
  RCC_OscInitStruct.OscillatorType = RCC_OSCILLATORTYPE_HSI;
  RCC_OscInitStruct.HSIState = RCC_HSI_ON;
  RCC_OscInitStruct.HSICalibrationValue = RCC_HSICALIBRATION_DEFAULT;
  RCC_OscInitStruct.PLL.PLLState = RCC_PLL_NONE;
  if (HAL_RCC_OscConfig(&RCC_OscInitStruct) != HAL_OK)
  {
    Error_Handler();
  }

  /** Initializes the CPU, AHB and APB buses clocks
  */
  RCC_ClkInitStruct.ClockType = RCC_CLOCKTYPE_HCLK|RCC_CLOCKTYPE_SYSCLK
                              |RCC_CLOCKTYPE_PCLK1|RCC_CLOCKTYPE_PCLK2;
  RCC_ClkInitStruct.SYSCLKSource = RCC_SYSCLKSOURCE_HSI;
  RCC_ClkInitStruct.AHBCLKDivider = RCC_SYSCLK_DIV1;
  RCC_ClkInitStruct.APB1CLKDivider = RCC_HCLK_DIV1;
  RCC_ClkInitStruct.APB2CLKDivider = RCC_HCLK_DIV1;

  if (HAL_RCC_ClockConfig(&RCC_ClkInitStruct, FLASH_LATENCY_0) != HAL_OK)
  {
    Error_Handler();
  }
}

static void MX_GPIO_Init(void)
{
  GPIO_InitTypeDef GPIO_InitStruct = {0};

  /* GPIO Ports Clock Enable */
  __HAL_RCC_GPIOC_CLK_ENABLE();
  __HAL_RCC_GPIOA_CLK_ENABLE();
  __HAL_RCC_GPIOB_CLK_ENABLE();

  /*Configure GPIO pin : PC13 */
  GPIO_InitStruct.Pin = GPIO_PIN_13;
  GPIO_InitStruct.Mode = GPIO_MODE_IT_RISING;
  GPIO_InitStruct.Pull = GPIO_NOPULL;
  HAL_GPIO_Init(GPIOC, &GPIO_InitStruct);

  /* EXTI interrupt init*/
  HAL_NVIC_SetPriority(EXTI15_10_IRQn, 5, 0);
  HAL_NVIC_EnableIRQ(EXTI15_10_IRQn);

}

/* USER CODE BEGIN 4 */

void HAL_GPIO_EXTI_Callback(uint16_t GPIO_Pin)
{
    if (GPIO_Pin == GPIO_PIN_13)
    {
        // signaler l'événement à FreeRTOS
    	osSemaphoreRelease(ButtonSemaphoreHandle);
    }
}

/* USER CODE END 4 */

void StartTask1(void *argument)
{
  /* USER CODE BEGIN 5 */
  uint32_t counter = 1;
  SqrtResult_t data;
  for(;;)
  {

	data.number = counter;
	data.result = calculate_sqrt(counter);

	osMessageQueuePut(ProcessingQueueHandle,
					  &data,
					  0,
					  0);

	counter++;

	osDelay(1000);

  }
  /* USER CODE END 5 */
}

void StartTask2(void *argument)
{
  /* USER CODE BEGIN StartTask2 */
  /* Infinite loop */
	SqrtResult_t data;
	for(;;)
	{
		if (osMessageQueueGet(ProcessingQueueHandle,
							  &data,
							  NULL,
							  osWaitForever) == osOK)
		{
			osMutexAcquire(PrintMutexHandle, osWaitForever);
			printf("----> sqrt(%lu) = %.3f\n", data.number, data.result);
			osMutexRelease(PrintMutexHandle);
		}
	}
  /* USER CODE END StartTask2 */
}

void StartTask3(void *argument)
{
  /* USER CODE BEGIN StartTask3 */
  /* Infinite loop */
	for (;;)
	    {
	        osSemaphoreAcquire(ButtonSemaphoreHandle, osWaitForever);

	        osMutexAcquire(PrintMutexHandle, osWaitForever);

	        printf("\n");
	        printf("========== SYSTEM MONITOR ==========\n");

	        printf("Task1 state : %s\n",
	               GetTaskStateName(osThreadGetState(Task1Handle)));

	        printf("Task2 state : %s\n",
	               GetTaskStateName(osThreadGetState(Task2Handle)));

	        printf("Task3 state : %s\n",
	               GetTaskStateName(osThreadGetState(Task3Handle)));

	        printf("====================================\n");

	        printf("Queue : %lu / %lu\n",
	               osMessageQueueGetCount(ProcessingQueueHandle),
	               osMessageQueueGetCapacity(ProcessingQueueHandle));

	        printf("====================================\n");

	        printf("Task1 stack free : %lu words\n",
	               uxTaskGetStackHighWaterMark(Task1Handle));

	        printf("Task2 stack free : %lu words\n",
	               uxTaskGetStackHighWaterMark(Task2Handle));

	        printf("Task3 stack free : %lu words\n",
	               uxTaskGetStackHighWaterMark(Task3Handle));

	        printf("====================================\n");

	        osMutexRelease(PrintMutexHandle);
	    }
  /* USER CODE END StartTask3 */
}

/* MonitorTimerCallback function */
void MonitorTimerCallback(void *argument)
{
  /* USER CODE BEGIN MonitorTimerCallback */
	printf("TIMER EVENT : Take a Break DUDE!\n");
  /* USER CODE END MonitorTimerCallback */
}

void HAL_TIM_PeriodElapsedCallback(TIM_HandleTypeDef *htim)
{
  if (htim->Instance == TIM6)
  {
    HAL_IncTick();
  }
}

void Error_Handler(void)
{
  __disable_irq();
  while (1)
  {
  }
}
